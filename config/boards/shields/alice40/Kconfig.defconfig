## config/boards/shields/alice40/Kconfig.defconfig
```kconfig
if SHIELD_ALICE40_LEFT

config ZMK_KEYBOARD_NAME
    default "Alice 40"

config ZMK_SPLIT_ROLE_CENTRAL
    default y

endif

if SHIELD_ALICE40_LEFT || SHIELD_ALICE40_RIGHT

config ZMK_SPLIT
    default y

endif
```

## config/boards/shields/alice40/Kconfig.shield
```kconfig
# Copyright (c) 2020 Pete Johanson
# SPDX-License-Identifier: MIT

config SHIELD_ALICE40_LEFT
    def_bool $(shields_list_contains,alice40_left)

config SHIELD_ALICE40_RIGHT
    def_bool $(shields_list_contains,alice40_right)
```
